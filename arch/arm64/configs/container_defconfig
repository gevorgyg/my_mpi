## arch/arm64/configs/container_defconfig
```kconfig
# Container defconfig for macOS container tool + MPI syscalls
# Based on arm64 defconfig with container-specific additions.
#
# Usage (inside Linux build container):
#   cd /linux
#   make mrproper
#   make defconfig
#   scripts/config --enable VSOCKETS
#   scripts/config --enable VIRTIO_VSOCKETS
#   scripts/config --enable VIRTIO_FS
#   scripts/config --enable FUSE_FS
#   scripts/config --enable OVERLAY_FS
#   scripts/config --enable SQUASHFS
#   scripts/config --enable SQUASHFS_XZ
#   scripts/config --enable SQUASHFS_ZSTD
#   scripts/config --enable NET_9P
#   scripts/config --enable NET_9P_VIRTIO
#   scripts/config --enable 9P_FS
#   scripts/config --enable 9P_FS_POSIX_ACL
#   scripts/config --enable USER_NS
#   scripts/config --enable POSIX_MQUEUE
#   scripts/config --enable BLK_DEV_INITRD
#   make olddefconfig
#   make -j$(nproc) Image
#
# Or use the merge script below.

# ---- Everything below merges ON TOP of defconfig ----

# Virtio vsock (container agent socket)
CONFIG_VSOCKETS=y
CONFIG_VIRTIO_VSOCKETS=y

# VirtioFS (host volume mounts)
CONFIG_VIRTIO_FS=y
CONFIG_FUSE_FS=y

# 9P (host filesystem sharing)
CONFIG_NET_9P=y
CONFIG_NET_9P_VIRTIO=y
CONFIG_9P_FS=y
CONFIG_9P_FS_POSIX_ACL=y

# Container filesystem layers
CONFIG_OVERLAY_FS=y
CONFIG_SQUASHFS=y
CONFIG_SQUASHFS_XZ=y
CONFIG_SQUASHFS_ZSTD=y

# Namespaces
CONFIG_NAMESPACES=y
CONFIG_UTS_NS=y
CONFIG_IPC_NS=y
CONFIG_PID_NS=y
CONFIG_NET_NS=y
CONFIG_USER_NS=y

# cgroups
CONFIG_CGROUPS=y
CONFIG_CGROUP_CPUACCT=y
CONFIG_CGROUP_SCHED=y
CONFIG_CGROUP_FREEZER=y
CONFIG_CGROUP_DEVICE=y
CONFIG_CGROUP_PIDS=y
CONFIG_MEMCG=y
CONFIG_CPUSETS=y

# initramfs
CONFIG_BLK_DEV_INITRD=y
CONFIG_RD_GZIP=y
CONFIG_RD_XZ=y
CONFIG_RD_ZSTD=y

# MPI testing
CONFIG_POSIX_MQUEUE=y
```
